/dts-v1/;
/plugin/;

#include "asus/vodka-overlay.dtsi"

/ {
	model = "Qualcomm Technologies, Inc. VODKA MP";
	compatible = "qcom,lahaina-mtp", "qcom,lahaina", "qcom,mtp";
	qcom,board-id = <100 0>;
};
