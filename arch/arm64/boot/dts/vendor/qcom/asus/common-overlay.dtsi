/*
 * Common dtsi overlay changes for Asus lahaina platform
 */

#include "common-regulators.dtsi"
#include "common-thermal.dtsi"

&display_panel_avdd {
	/delete-property/ gpio;
	/delete-property/ pinctrl-names;
	/delete-property/ pinctrl-0;
};

&pm8350c_pwm_1 {
	qcom,lut-patterns = <10 10 10 10 0 0 0 0 0 0 0
					0 0 0 0 0 0 0 0 0 0>;
};
