## drivers/nfc/pn8xt/Kconfig
```kconfig
#
# Copyright (C) 2019 NXP
#
# SPDX-License-Identifier: GPL-2.0
#

config NXP_NFC_ESE_DEVICE
	tristate "NXP NFC ESE Driver Controller"

source "drivers/nfc/pn8xt/ese/Kconfig"
source "drivers/nfc/pn8xt/nfc/Kconfig"
```

## drivers/nfc/pn8xt/nfc/Kconfig
```kconfig
#
# Copyright (C) 2019 NXP
#
# SPDX-License-Identifier: GPL-2.0
#

config NXP_NFC_SN1XX
	default n
	depends on !NFC_QTI_I2C
	bool "Nxp NFC sn1xx Controller"
	---help---
	  You'll have to say Y if your computer contains an sn1xx I2C device that
	  you want to use under Linux.

	  You can say N here if you don't have any sn1xx I2C connected to your computer.

config NXP_NFC_PN8XT
	default n
	depends on !NFC_QTI_I2C
	bool "Nxp NFC pn8xt Controller"
	---help---
	  You'll have to say Y if your computer contains an pn8xt I2C device that
	  you want to use under Linux.

	  You can say N here if you don't have any pn8xt I2C connected to your computer.
```

## drivers/platform/asus/Kconfig
```kconfig
# Asus configuration options

config MACH_ASUS
	bool "Asus device"
	help
	  Support for Asus products

menu "Asus board selection"

config MACH_ASUS_SAKE
	bool "SAKE board"
	select MACH_ASUS
	help
	  Support for Sake

config MACH_ASUS_VODKA
	bool "VODKA board"
	select MACH_ASUS
	help
	  Support for Vodka

endmenu
```

## drivers/sensors/Kconfig
```kconfig
config SENSORS_ICM206XX
	tristate "ICM206XX 6-axis gyroscope and acceleromater combo"
	depends on INPUT && SPI
	help
	  Say Y here if you want to support InvenSense ICM206XX
	  connected via an I2C bus.

	  To compile this driver as a module, choose M here: the
	  module will be called ICM206XX.
```
